## bitbake-builds/poky-whinlatter/build/conf/bblayers.conf
```bitbake
BBLAYERS ?= " \
  ${TOPDIR}/../../../bitbake-builds/poky-whinlatter/layers/openembedded-core/meta \
  ${TOPDIR}/../../../bitbake-builds/poky-whinlatter/layers/meta-openembedded/meta-oe \
  ${TOPDIR}/../../../bitbake-builds/poky-whinlatter/layers/meta-openembedded/meta-multimedia \
  ${TOPDIR}/../../../bitbake-builds/poky-whinlatter/layers/meta-openembedded/meta-python \
  ${TOPDIR}/../../../bitbake-builds/poky-whinlatter/layers/meta-yocto/meta-yocto-bsp \
  ${TOPDIR}/../../../bitbake-builds/poky-whinlatter/layers/meta-yocto/meta-poky \
  ${TOPDIR}/../../../bitbake-builds/poky-whinlatter/layers/meta-arm/meta-arm-toolchain \
  ${TOPDIR}/../../../bitbake-builds/poky-whinlatter/layers/meta-arm/meta-arm \
  ${TOPDIR}/../../../bitbake-builds/poky-whinlatter/layers/meta-rockchip \
  ${TOPDIR}/../../../bitbake-builds/poky-whinlatter/layers/meta-swupdate \
  ${TOPDIR}/../../../meta-brutzelboy \
  ${TOPDIR}/../../../meta-pm-thebrutzler \
  ${TOPDIR}/../../../meta-platinenmacher \
  "
```

## meta-brutzelboy/conf/layer.conf
```bitbake
# We have a conf and classes directory, add to BBPATH
BBPATH .= ":${LAYERDIR}"

# We have recipes-* directories, add to BBFILES
BBFILES += "${LAYERDIR}/recipes-*/*/*.bb \
            ${LAYERDIR}/recipes-*/*/*.bbappend"

BBFILE_COLLECTIONS += "meta-brutzelboy"
BBFILE_PATTERN_meta-brutzelboy = "^${LAYERDIR}/"
BBFILE_PRIORITY_meta-brutzelboy = "10"

LAYERDEPENDS_meta-brutzelboy = "core meta-platinenmacher meta-pm-thebrutzler"
LAYERSERIES_COMPAT_meta-brutzelboy = "whinlatter"
```

## meta-platinenmacher/conf/distro/platinenmacher-linux.conf
```bitbake
#
# Platinenmacher Linux for embedded devices based on poky
#
require conf/distro/poky.conf

DISTRO_NAME = "Platinenmacher Linux (based on poky)"
POKY_VERSION := "${DISTRO_VERSION}"
DISTRO_VERSION = "2026.01.2-poky-${POKY_VERSION}"
DISTRO = "platinenmacher-linux"
DISTROOVERRIDES = "poky:platinenmacher-linux"

VENDOR = "platinenmacher"
TARGET_VENDOR = "-${VENDOR}"

LICENSE_FLAGS_ACCEPTED = "commercial"

# We use systemd as init manager
POKY_INIT_MANAGER:platinenmacher-linux = "systemd"

# Add extra DISTRO_FEATUREs
DISTRO_FEATURES:append = " pam usrmerge"

# Use our alternate kernel version
PREFERRED_VERSION_linux-yocto = "6.18%"

# Create /etc/build
INHERIT += "image-buildinfo"
IMAGE_BUILDINFO_VARS:append = " DATETIME DISTRO_NAME IMAGE_BASENAME MACHINE TUNE_PKGARCH"
IMAGE_BUILDINFO_VARS:append = " MACHINE_FEATURES DISTRO_FEATURES IMAGE_FEATURES"

# All images build with the distribution get the version package
IMAGE_INSTALL:append = " os-release"

# QA settings
INHERIT += "sanity"
INHERIT += "insane"
# configure insane.bbclass
ERROR_TO_WARN_QA = "version-going-backwards"
ERROR_QA:remove = "${ERROR_TO_WARN_QA}"
WARN_QA:append = " ${ERROR_TO_WARN_QA}"

VIRTUAL-RUNTIME_syslog = ""
VIRTUAL-RUNTIME_initscripts = ""

# default value in bitbake.conf of poky is '/home/root'
# change to '/root' as this is preferred path
ROOT_HOME ?= "/root"

# Use iwd instead of wpa-supplicant for WiFi management
WIRELESS_DAEMON = "iwd"

# Completely blacklist wpa-supplicant to prevent it from being included
PACKAGE_EXCLUDE += "wpa-supplicant"

DISTRO_FEATURES_DEFAULT:remove = "pcmcia zeroconf 3g"
DISTRO_FEATURES = "${DISTRO_FEATURES_DEFAULT} \
                   bluetooth \
                   crun \
                   kernelmodsign \
                   opengl \
                   pam \
                   security \
                   swupdate \
    ${@bb.utils.filter('MACHINE_FEATURES', 'tpm tpm2', d)} \
                   usbgadget \
                   virtualization \
                   wayland \
                   x-wayland \
                   wifi \
"
```

## meta-platinenmacher/conf/layer.conf
```bitbake
# We have a conf and classes directory, add to BBPATH
BBPATH .= ":${LAYERDIR}"

# We have recipes-* directories, add to BBFILES
BBFILES += "${LAYERDIR}/recipes-*/*/*.bb \
            ${LAYERDIR}/recipes-*/*/*.bbappend"

BBFILE_COLLECTIONS += "meta-platinenmacher"
BBFILE_PATTERN_meta-platinenmacher = "^${LAYERDIR}/"
BBFILE_PRIORITY_meta-platinenmacher = "99"

LAYERDEPENDS_meta-platinenmacher = "core"
LAYERSERIES_COMPAT_meta-platinenmacher = "whinlatter"
```

## meta-pm-thebrutzler/conf/layer.conf
```bitbake
# We have a conf and classes directory, add to BBPATH
BBPATH .= ":${LAYERDIR}"

# We have recipes-* directories, add to BBFILES
BBFILES += "${LAYERDIR}/recipes-*/*/*.bb \
            ${LAYERDIR}/recipes-*/*/*.bbappend"

BBFILE_COLLECTIONS += "meta-pm-thebrutzler"
BBFILE_PATTERN_meta-pm-thebrutzler = "^${LAYERDIR}/"
BBFILE_PRIORITY_meta-pm-thebrutzler = "99"

LAYERDEPENDS_meta-pm-thebrutzler = " \
    core \
    meta-arm \
    rockchip \
"
LAYERSERIES_COMPAT_meta-pm-thebrutzler = "whinlatter"
```

## meta-pm-thebrutzler/conf/machine/thebrutzler_v1.conf
```bitbake
#@TYPE: Machine
#@NAME: Radxa Zero 3E
#@DESCRIPTION: The Radxa ZERO 3e is an ultra-small, high-performance single board computer based on the Rockchip RK3566, with a compact form factor, and rich interfaces.
#http://radxa.com/products/zeros/zero3e/

MACHINEOVERRIDES =. "thebrutzler-v1:"

require conf/machine/include/rk3568.inc

PREFERRED_PROVIDER_virtual/kernel = "linux-yocto-dev"
MACHINE_EXTRA_RRECOMMENDS += "kernel-modules"
MACHINE_EXTRA_RRECOMMENDS += "kernel-module-brcmfmac linux-firmware-bcm43xx linux-firmware-bcm43430 linux-firmware-bcm43430a0"
PACKAGE_INSTALL:append = " ${MACHINE_EXTRA_RRECOMMENDS}"

UBOOT_MACHINE = "evb-rk3568_defconfig"

KERNEL_DEVICETREE = "rockchip/lcsc-taishanpi-rk3566.dtb"

# Override kernel settings from rk3566.inc - fitImage is no longer a valid KERNEL_IMAGETYPE
# FIT images are now built by a separate linux-yocto-fitimage recipe
KERNEL_CLASSES = "kernel-fit-extra-artifacts"
KERNEL_IMAGETYPE = "Image"

MACHINE_FEATURES =  "alsa bluetooth optee rtc screen usbhost usbgadget wifi"
```

## meta-pm-thebrutzler/conf/machine/thebrutzler_v2.conf
```bitbake
#@TYPE: Machine
#@NAME: The Brutzler V2
#@DESCRIPTION: Based on the LCSC Taishan Pi RK3566


MACHINEOVERRIDES =. "thebrutzler-v2:"

require conf/machine/include/rk3568.inc

PREFERRED_PROVIDER_virtual/kernel = "linux-yocto-dev"
MACHINE_EXTRA_RRECOMMENDS += "kernel-modules"
MACHINE_EXTRA_RRECOMMENDS += "kernel-module-brcmfmac linux-firmware-bcm43xx linux-firmware-bcm43430 linux-firmware-bcm43430a0"
PACKAGE_INSTALL:append = " ${MACHINE_EXTRA_RRECOMMENDS}"

UBOOT_MACHINE = "lckfb-tspi-rk3566_defconfig"

KERNEL_DEVICETREE = "rockchip/lcsc-taishanpi-rk3566.dtb"

# Override kernel fitimage settings from rk3568.inc for Whinlatter compatibility
# rk3568.inc uses old class name "kernel-fitimage", we need "kernel-fit-image"
KERNEL_CLASSES = "kernel-fit-extra-artifacts"
KERNEL_IMAGETYPE = "Image"

# To enable FIT image generation, use the linux-yocto-fitimage recipe
# which will generate a FIT image containing kernel + device tree
# Note: This is separate from KERNEL_IMAGETYPE which is just the raw kernel

# Ensure the FIT image recipe is built and deployed for this machine
MACHINE_ESSENTIAL_EXTRA_RDEPENDS += "linux-yocto-fitimage"
KERNEL_DEPLOY_DEPEND += "linux-yocto-fitimage:do_deploy"

MACHINE_FEATURES =  "alsa bluetooth optee rk-u-boot-env rtc screen usbhost usbgadget wifi"
```

## meta-pm-thebrutzler/wic/platinenmacher-ab.wks
```
# A/B partition layout for swupdate with persistent user data
# Rockchip bootloader partitions (inherited from rockchip.wks)

part loader1   --offset 64s    --fixed-size 3552K --fstype=none --part-name loader1   --source rawcopy --sourceparams="file=${SPL_BINARY}"
part v_storage --offset 7168s  --fixed-size 256K  --fstype=none --part-name v_storage
part reserved  --offset 7680s  --fixed-size 192K  --fstype=none --part-name reserved
part reserved1 --offset 8064s  --fixed-size 32K   --fstype=none --part-name reserved1
part uboot_env --offset 8128s  --fixed-size 32K   --fstype=none --part-name uboot_env ${RK_UBOOT_ENV}
part reserved2 --offset 8192s  --fixed-size 4096K --fstype=none --part-name reserved2
part loader2   --offset 16384s --fixed-size 4096K --fstype=none --part-name loader2   --source rawcopy --sourceparams="file=u-boot.${UBOOT_SUFFIX}"
part atf       --offset 24576s --fixed-size 4096K --fstype=none --part-name atf

# Rescue Partition
part           --label rescue --fstype=ext4 --part-name rescue --fixed-size 512M --part-type ${ROOT_DPS}

# Root filesystem A (active) - 2GB size
part /         --label rootfsA  --active          --fstype=ext4 --part-name rootfsA   --source rootfs  --fixed-size 2048M --part-type ${ROOT_DPS}
# Root filesystem B (inactive, empty partition for updates) - 2GB size
part           --label rootfsB  --active                  --fstype=ext4 --part-name rootfsB   --fixed-size 2048M --part-type ${ROOT_DPS}
# User data partition (will be resized at first boot to fill remaining space)
# Mount via systemd unit with PARTLABEL instead of WKS auto-mount
part           --label userdata                   --fstype=ext4 --part-name userdata  --fixed-size 256M  --part-type ${ROOT_DPS}

bootloader --ptable gpt
```
